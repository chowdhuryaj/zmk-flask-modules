## Kconfig
```kconfig
DT_COMPAT_ZMK_INPUT_PROCESSOR_FLASK_SCROLL := zmk,input-processor-flask-scroll

config ZMK_INPUT_PROCESSOR_FLASK_SCROLL
    bool "Flask rate-capped scroll input processor"
    default $(dt_compat_enabled,$(DT_COMPAT_ZMK_INPUT_PROCESSOR_FLASK_SCROLL))
    depends on ZMK_POINTING
    depends on INPUT
    help
      Converts relative trackball motion into rate-capped wheel notches:
      integer divisor with remainder carry, fixed dump interval, per-interval
      notch cap, surplus carried forward. Port of the Flask (QMK) drag-scroll
      conversion — keeps slow scroll consumers from flooding or reversing
      under fast ball rolls, with no lost counts.

DT_COMPAT_ZMK_INPUT_PROCESSOR_FLASK_AUTOSCROLL := zmk,input-processor-flask-autoscroll

config ZMK_INPUT_PROCESSOR_FLASK_AUTOSCROLL
    bool "Flask autoscroll input processor"
    default $(dt_compat_enabled,$(DT_COMPAT_ZMK_INPUT_PROCESSOR_FLASK_AUTOSCROLL))
    depends on ZMK_POINTING
    depends on INPUT
    help
      Hands-free continuous scrolling — port of the Flask (QMK) autoscroll
      module. Stepped mode: a signed speed level (-9..9) ticks the wheel at
      Ben White's canonical intervals (1000..25 ms). Jog mode: the ball
      becomes a jog wheel (vertical deflection = direction/speed, motion
      swallowed). Controlled by the &asc behavior; any other key press
      stops it (runtime-tunable).

DT_COMPAT_ZMK_BEHAVIOR_FLASK_AUTOSCROLL := zmk,behavior-flask-autoscroll

config ZMK_BEHAVIOR_FLASK_AUTOSCROLL
    bool "Flask autoscroll behavior (&asc)"
    default $(dt_compat_enabled,$(DT_COMPAT_ZMK_BEHAVIOR_FLASK_AUTOSCROLL))
    depends on ZMK_INPUT_PROCESSOR_FLASK_AUTOSCROLL
    help
      Keymap behavior driving the flask autoscroll processor:
      &asc ASC_UP / ASC_DOWN / ASC_JOG / ASC_STOP.

DT_COMPAT_ZMK_INPUT_PROCESSOR_FLASK_ACCEL := zmk,input-processor-flask-accel

config ZMK_INPUT_PROCESSOR_FLASK_ACCEL
    bool "Flask pointer acceleration input processor"
    default $(dt_compat_enabled,$(DT_COMPAT_ZMK_INPUT_PROCESSOR_FLASK_ACCEL))
    depends on ZMK_POINTING
    depends on INPUT
    help
      Sigmoid-curve pointer acceleration — port of the Flask (QMK) pd_accel
      module (drashna's pointing_device_accel). Scales REL_X/REL_Y in the
      listener chain by a velocity-driven factor; takeoff/growth/offset/
      limit are runtime-tunable over the Flask protocol (channel 0x10).

DT_COMPAT_ZMK_INPUT_PROCESSOR_FLASK_SCROLLSCALE := zmk,input-processor-flask-scrollscale

config ZMK_INPUT_PROCESSOR_FLASK_SCROLLSCALE
    bool "Flask runtime scroll speed scaler"
    default $(dt_compat_enabled,$(DT_COMPAT_ZMK_INPUT_PROCESSOR_FLASK_SCROLLSCALE))
    depends on ZMK_POINTING
    depends on INPUT
    help
      Drop-in replacement for the stock zip_x_scaler / zip_y_scaler on a
      scroll ball's chain: identical math (in-place divide, remainder carry
      via the listener's per-entry storage), with the compiled divisor
      scaled by a live speed percent over the Flask protocol (channel 0x29,
      SAVE persists via "flask/scrollscale"). ZMK's scaler divisors are
      devicetree params — const config — so scroll speed otherwise needs a
      reflash. Speed 100 = the keymap's compiled divisors verbatim, so the
      default feel is unchanged by construction. Distinct from
      ZMK_INPUT_PROCESSOR_FLASK_SCROLL, which is a rate-capped timer-based
      converter with a different feel.

DT_COMPAT_ZMK_INPUT_PROCESSOR_FLASK_SCROLLSNAP := zmk,input-processor-flask-scrollsnap

config ZMK_INPUT_PROCESSOR_FLASK_SCROLLSNAP
    bool "Flask scroll axis snap/lock input processor"
    default $(dt_compat_enabled,$(DT_COMPAT_ZMK_INPUT_PROCESSOR_FLASK_SCROLLSNAP))
    depends on ZMK_POINTING
    depends on INPUT
    help
      Runtime-tunable port of kot149/zmk-scroll-snap: snaps slightly
      diagonal wheel motion onto the dominant axis and can lock that axis
      for a duration/event count. Every knob is live over the Flask
      protocol (channel 0x26).

DT_COMPAT_ZMK_INPUT_PROCESSOR_FLASK_AUTOMOUSE := zmk,input-processor-flask-automouse

config ZMK_INPUT_PROCESSOR_FLASK_AUTOMOUSE
    bool "Flask auto-mouse layer input processor"
    default $(dt_compat_enabled,$(DT_COMPAT_ZMK_INPUT_PROCESSOR_FLASK_AUTOMOUSE))
    depends on ZMK_POINTING
    depends on INPUT
    help
      Runtime-tunable auto-mouse layer (replaces &zip_temp_layer on the
      cursor chain): ball motion past a movement threshold activates a
      layer; a timeout drops it, or — timeout 0 — it latches until a key
      transparent on the layer is pressed (that key is swallowed).
      Non-transparent keys on the layer can extend the timeout. All knobs
      live over the Flask protocol (channel 0x1B, the QMK autoMouse wire
      shape) and persist via settings.

DT_COMPAT_FLASK_RGB := flask,rgb

config ZMK_FLASK_RGB
    bool "Flask per-key per-layer RGB map"
    default $(dt_compat_enabled,$(DT_COMPAT_FLASK_RGB))
    depends on LED_STRIP
    help
      Runtime-editable per-key per-layer HSV map (the ZMK analog of the QMK
      Flask RGBMAP feature, channel 0x21). Both split halves hold the full
      map and render their own slice; the active layer and map edits reach
      the peripheral over a module-owned split GATT characteristic. Keep
      ZMK_RGB_UNDERGLOW off — both would drive the same strip.

config ZMK_FLASK_RGB_LED_OFFSET
    int "Global index of this half's first LED"
    depends on ZMK_FLASK_RGB
    default 0
    help
      Where this build's strip sits in the global LED index space: 0 on the
      central half; the central's led-count on the peripheral (set via
      build.yaml cmake-args on the peripheral build).

DT_COMPAT_ZMK_BEHAVIOR_FLASK_RGB := zmk,behavior-flask-rgb

config ZMK_BEHAVIOR_FLASK_RGB
    bool "Flask RGB behavior (&frgb)"
    default $(dt_compat_enabled,$(DT_COMPAT_ZMK_BEHAVIOR_FLASK_RGB))
    depends on ZMK_FLASK_RGB
    help
      Keymap behavior controlling the flask_rgb map:
      &frgb FRGB_TOG / FRGB_ON / FRGB_OFF.

config ZMK_FLASK_PROTO
    bool "Flask raw-HID runtime tuning protocol"
    depends on RAW_HID
    depends on SETTINGS
    help
      Speaks the Flask tuning frame ([cmd, channel, value_id, u16 BE] in
      32-byte reports) over zzeneg/zmk-raw-hid, exposing runtime knobs to
      the Flask desktop/web configurators. Per-module channels (dragscroll,
      autoscroll) compile only when their module does; absent channels
      answer unhandled. Saved values persist via Zephyr settings.

config ZMK_FLASK_COMBOS
    bool "Flask runtime combos"
    depends on SETTINGS
    select ZMK_BEHAVIOR_LOCAL_IDS
    help
      Runtime-editable combos (the Vial dynamic-combos analog): Kconfig-
      sized slots of key positions firing a typed output (usage / macro /
      behavior by local id), with per-combo timeout, prior-idle and layer
      gates since v14, edited live over the Flask protocol (channel 0x24)
      and persisted via settings. ZMK's devicetree combos are const config
      and ZMK Studio has no combo RPC — this module is the live-editing
      path; a keymap can compile default combos into it via a
      `flask,combos-defaults` node (the imported DT combos). LOCAL_IDS is
      selected so behavior-typed outputs and compiled defaults work on
      every image, not just Studio builds. Central-only on splits (no DT
      node — enable explicitly in the board .conf).

config ZMK_FLASK_COMBOS_SLOTS
    int "Runtime combo slots"
    depends on ZMK_FLASK_COMBOS
    range 1 64
    default 64
    help
      How many runtime combos the table holds. Bounded by the matcher's
      u64 candidate bitmask (64) and settings-partition budget — each live
      slot persists as its own settings entry.

config ZMK_FLASK_COMBOS_KEYS
    int "Max key positions per combo"
    depends on ZMK_FLASK_COMBOS
    range 2 8
    default 8
    help
      Positions one combo can bind (Vial caps this at 4; the 32-byte Flask
      frame fits 8). Also sizes the capture buffer.

config ZMK_FLASK_MACROS
    bool "Flask runtime macros"
    depends on SETTINGS
    help
      Runtime-editable macros (the Vial dynamic-macros analog): 16 slots of
      up to 16 tap/press/release/wait steps raising encoded
      keycode+modifier usages, edited live over the Flask protocol
      (channel 0x25) and persisted via settings. ZMK's devicetree macros
      are const config and ZMK Studio has no macro RPC — this module is
      the live-editing path. Triggered by the &fmac behavior or the
      protocol's play value. Central-only on splits (enable explicitly in
      the board .conf; the &fmac keymap node auto-enables only the
      behavior below).

config ZMK_FLASK_MACROS_SLOTS
    int "Runtime macro slots"
    depends on ZMK_FLASK_MACROS
    range 1 64
    default 32
    help
      How many runtime macros the table holds. Each used slot persists as
      its own settings entry — RAM and the settings partition are the only
      real bounds.

config ZMK_FLASK_MACROS_STEPS
    int "Steps per macro slot"
    depends on ZMK_FLASK_MACROS
    range 1 128
    default 32
    help
      Typed steps (tap/press/release/wait) one macro can hold.

config ZMK_FLASK_CSK
    bool "Flask custom shift keys"
    depends on SETTINGS
    help
      Runtime custom shift pairs (QMK custom_shift_keys analog, channel
      0x16): while Shift is held, a key whose base usage matches a slot
      sends the slot's shifted usage instead, with the physical Shift
      masked out of the report. Pure keycode-event hook — no per-key
      mod-morph nodes. Central-only on splits (no DT node — enable
      explicitly in the board .conf).

config ZMK_FLASK_CSK_SLOTS
    int "Custom shift key slots"
    depends on ZMK_FLASK_CSK
    range 1 32
    default 16
    help
      How many base/shifted pairs the table holds (QMK CSK_SLOTS is 16).

config ZMK_FLASK_TAPDANCE
    bool "Flask runtime tap dances"
    depends on SETTINGS
    select ZMK_BEHAVIOR_LOCAL_IDS
    help
      Runtime-editable tap dances (channel 0x28): the &ftd behavior runs a
      slot's dance — core zmk,behavior-tap-dance semantics with the const
      DT config swapped for a live-editable table (per-slot tapping term +
      typed output per tap count). ZMK's native tap-dance compiles one
      node per dance; this is the app-editable path. LOCAL_IDS selected so
      behavior-typed outputs work on every image. Central-only on splits
      (enable explicitly in the board .conf; the &ftd keymap node
      auto-enables only the behavior below).

config ZMK_FLASK_TAPDANCE_SLOTS
    int "Runtime tap dance slots"
    depends on ZMK_FLASK_TAPDANCE
    range 1 64
    default 16

config ZMK_FLASK_TAPDANCE_TAPS
    int "Outputs per tap dance (max tap count)"
    depends on ZMK_FLASK_TAPDANCE
    range 2 8
    default 4

DT_COMPAT_ZMK_BEHAVIOR_FLASK_TAPDANCE := zmk,behavior-flask-tapdance

config ZMK_BEHAVIOR_FLASK_TAPDANCE
    bool "Flask tap dance behavior (&ftd)"
    default $(dt_compat_enabled,$(DT_COMPAT_ZMK_BEHAVIOR_FLASK_TAPDANCE))
    depends on ZMK_FLASK_TAPDANCE
    help
      Keymap behavior running a flask_tapdance slot: &ftd <slot>.

config ZMK_FLASK_LEADER
    bool "Flask runtime leader sequences"
    depends on SETTINGS
    help
      Runtime-editable leader sequences (channel 0x19): the &fled behavior
      opens a capture, key positions match the app-edited table, an
      unambiguous match fires a typed output (usage tap or flask_macros
      slot). Coexists with urob's compile-time leader key. Central-only on
      splits (no engine DT node — enable explicitly in the board .conf; the
      &fled keymap node auto-enables only the behavior below).

config ZMK_FLASK_LEADER_SLOTS
    int "Runtime leader sequence slots"
    depends on ZMK_FLASK_LEADER
    range 1 64
    default 32

config ZMK_FLASK_LEADER_KEYS
    int "Max keys per leader sequence"
    depends on ZMK_FLASK_LEADER
    range 2 8
    default 8

DT_COMPAT_ZMK_BEHAVIOR_FLASK_LEADER := zmk,behavior-flask-leader

config ZMK_BEHAVIOR_FLASK_LEADER
    bool "Flask leader behavior (&fled)"
    default $(dt_compat_enabled,$(DT_COMPAT_ZMK_BEHAVIOR_FLASK_LEADER))
    depends on ZMK_FLASK_LEADER
    help
      Keymap behavior opening a flask_leader capture: &fled.

DT_COMPAT_ZMK_INPUT_PROCESSOR_FLASK_GESTURES := zmk,input-processor-flask-gestures

config ZMK_INPUT_PROCESSOR_FLASK_GESTURES
    bool "Flask runtime mouse gestures input processor"
    default $(dt_compat_enabled,$(DT_COMPAT_ZMK_INPUT_PROCESSOR_FLASK_GESTURES))
    depends on ZMK_POINTING
    depends on INPUT
    depends on SETTINGS
    help
      Runtime-editable mouse gestures (channel 0x11) — port of the Flask
      (QMK) pd_gestures ratchet engine. Direction outputs live in runtime
      sets; the &fges behavior holds a gesture open. Replaces
      kot149/zmk-mouse-gesture's compile-time stroke patterns.

config ZMK_FLASK_GESTURES_SETS
    int "Gesture sets"
    depends on ZMK_INPUT_PROCESSOR_FLASK_GESTURES
    range 1 16
    default 8

DT_COMPAT_ZMK_BEHAVIOR_FLASK_GESTURES := zmk,behavior-flask-gestures

config ZMK_BEHAVIOR_FLASK_GESTURES
    bool "Flask gestures behavior (&fges)"
    default $(dt_compat_enabled,$(DT_COMPAT_ZMK_BEHAVIOR_FLASK_GESTURES))
    depends on ZMK_INPUT_PROCESSOR_FLASK_GESTURES
    help
      Keymap behavior holding a gesture open: &fges <set> (255 = follow
      the live active set).

DT_COMPAT_ZMK_INPUT_PROCESSOR_FLASK_BALLSWAP := zmk,input-processor-flask-ballswap

config ZMK_INPUT_PROCESSOR_FLASK_BALLSWAP
    bool "Flask trackball role-swap input processor"
    default $(dt_compat_enabled,$(DT_COMPAT_ZMK_INPUT_PROCESSOR_FLASK_BALLSWAP))
    depends on ZMK_POINTING
    depends on INPUT
    depends on SETTINGS
    help
      Live trackball role swap (Flask channel 0x1B): one instance fronts
      each ball's physical listener chain; while a swap is in effect it
      swallows motion and re-emits it from its own node, where a second
      listener carries the other role's chain. Toggled state persists via
      settings (survives power cycle and reflash); a momentary hold
      composes by XOR.

DT_COMPAT_ZMK_BEHAVIOR_FLASK_BALLSWAP := zmk,behavior-flask-ballswap

config ZMK_BEHAVIOR_FLASK_BALLSWAP
    bool "Flask ball-swap behavior (&bswap)"
    default $(dt_compat_enabled,$(DT_COMPAT_ZMK_BEHAVIOR_FLASK_BALLSWAP))
    depends on ZMK_INPUT_PROCESSOR_FLASK_BALLSWAP
    help
      Keymap behavior driving flask_ballswap: &bswap 0 toggles the
      persisted swap, &bswap 1 swaps while held.

DT_COMPAT_ZMK_BEHAVIOR_FLASK_MACROS := zmk,behavior-flask-macros

config ZMK_BEHAVIOR_FLASK_MACROS
    bool "Flask macro behavior (&fmac)"
    default $(dt_compat_enabled,$(DT_COMPAT_ZMK_BEHAVIOR_FLASK_MACROS))
    depends on ZMK_FLASK_MACROS
    help
      Keymap behavior playing a flask_macros slot: &fmac <slot>.
```

## dts/bindings/behaviors/zmk,behavior-flask-autoscroll.yaml
```yaml
# SPDX-License-Identifier: MIT
description: |
  Flask autoscroll control behavior. Param (dt-bindings/flask/autoscroll.h)
  selects the action — ASC_UP / ASC_DOWN step the signed speed level (through
  zero = stop), ASC_STOP force-stops.

compatible: "zmk,behavior-flask-autoscroll"

properties:
  "#binding-cells":
    type: int
    required: true
    const: 1

binding-cells:
  - param1
```

## dts/bindings/behaviors/zmk,behavior-flask-ballswap.yaml
```yaml
# SPDX-License-Identifier: MIT
description: |
  Flask trackball role-swap behavior. Param selects the mode — 0 toggles the
  persisted swap (saved immediately; survives power cycle and reflash),
  1 swaps only while the key is held.

compatible: "zmk,behavior-flask-ballswap"

properties:
  "#binding-cells":
    type: int
    required: true
    const: 1

binding-cells:
  - param1
```
