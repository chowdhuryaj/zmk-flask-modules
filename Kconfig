## dts/bindings/behaviors/zmk,behavior-flask-gestures.yaml
```yaml
# SPDX-License-Identifier: MIT
description: |
  "Flask runtime-gesture trigger behavior. Param selects the gesture set
  held open (255 follows the live active set, Flask channel 0x11); ball
  motion ratchet-fires the set's direction outputs until release."

compatible: "zmk,behavior-flask-gestures"

properties:
  display-name:
    type: string
  "#binding-cells":
    type: int
    required: true
    const: 1

binding-cells:
  - param1
```

## dts/bindings/behaviors/zmk,behavior-flask-leader.yaml
```yaml
# SPDX-License-Identifier: MIT
description: |
  "Flask runtime-leader trigger behavior. No params; press opens a capture
  matched against the app-edited sequence table (edited over the Flask
  protocol, channel 0x19)."

compatible: "zmk,behavior-flask-leader"

properties:
  display-name:
    type: string
  "#binding-cells":
    type: int
    required: true
    const: 0

binding-cells: []
```

## dts/bindings/behaviors/zmk,behavior-flask-macros.yaml
```yaml
# SPDX-License-Identifier: MIT
description: |
  "Flask runtime-macro trigger behavior. Param selects the macro slot
  (0-15); press plays that slot's live-editable step table (edited over
  the Flask protocol, channel 0x25)."

compatible: "zmk,behavior-flask-macros"

properties:
  display-name:
    type: string
  "#binding-cells":
    type: int
    required: true
    const: 1

binding-cells:
  - param1
```

## dts/bindings/behaviors/zmk,behavior-flask-rgb.yaml
```yaml
# SPDX-License-Identifier: MIT
description: |
  Flask RGB map control behavior. Param (dt-bindings/flask/rgb.h) selects the
  action — FRGB_TOG toggles the per-layer map, FRGB_ON / FRGB_OFF force it.

compatible: "zmk,behavior-flask-rgb"

properties:
  "#binding-cells":
    type: int
    required: true
    const: 1

binding-cells:
  - param1
```

## dts/bindings/flask,combos-defaults.yaml
```yaml
# Compiled default combos for flask_combos (runtime combos, Flask channel
# 0x24). Same child shape as zmk,combos so a keymap's combos block migrates
# by moving it under this node — each child seeds one runtime slot, in
# declaration order, when settings hold nothing for that slot.
#
# Copyright (c) 2026 AJ
# SPDX-License-Identifier: MIT

description: "Default combo table for the flask_combos runtime engine"

compatible: "flask,combos-defaults"

child-binding:
  description: "One default combo (zmk,combos child shape)"

  properties:
    bindings:
      type: phandle-array
      required: true
    key-positions:
      type: array
      required: true
    timeout-ms:
      type: int
      description: "Candidate window for this combo, ms (0 or absent = the global window)"
    require-prior-idle-ms:
      type: int
      description: "Only fire when the last non-modifier tap is at least this old"
    layers:
      type: array
      description: "Layer indexes this combo is active on (first entry used; absent = all layers)"
```

## dts/bindings/flask,rgb.yaml
```yaml
# flask_rgb — per-key per-layer RGB map (runtime-editable, Flask channel 0x21).
#
# One node per build, shared by both split halves (same keymap/devicetree).
# The half-specific piece — where this half's LEDs sit in the global index
# space — is CONFIG_ZMK_FLASK_RGB_LED_OFFSET (set per-build in build.yaml;
# 0 on the central, the central's led-count on the peripheral).

description: Flask per-key per-layer RGB map

compatible: "flask,rgb"

properties:
  led-strip:
    type: phandle
    required: true
    description: The LED strip device this half renders to.

  led-count:
    type: int
    required: true
    description: Number of LEDs on this half's strip.

  total-leds:
    type: int
    required: true
    description: Total LEDs across the whole keyboard (map width).

  layers:
    type: int
    default: 10
    description: Layers in the color map (match the keymap's layer count).

  key-positions:
    type: array
    description: >
      Keymap position lit by each LED — entry i is the key position LED i
      sits under, total-leds entries. Lets position-addressed consumers
      (the reactive-overlay API, e.g. flask_leader candidate lighting)
      resolve positions to LEDs. Omit for identity (LED i = position i).
      On a split whose per-half chains run in per-half position order
      (the Imprint), this is where the interleaved row numbering gets
      flattened. If the bench paint sweep says the chain order differs,
      fix it HERE (one property), not in the consumers.
```

## dts/bindings/input_processors/zmk,input-processor-flask-accel.yaml
```yaml
description: "Flask pointer acceleration — drashna sigmoid curve, runtime-tunable over the Flask protocol (channel 0x10)"

compatible: "zmk,input-processor-flask-accel"

include: ip_zero_param.yaml

properties:
  takeoff:
    type: int
    default: 200
    description: "Curve steepness K, x100 (default 2.0; clamped 0.5..10)"
  growth-rate:
    type: int
    default: 25
    description: "Growth rate G, x100 (default 0.25; clamped 0..2)"
  offset:
    type: int
    default: 220
    description: "Sigmoid midpoint S, x100, signed (default 2.2; clamped -10..10)"
  limit:
    type: int
    default: 20
    description: "Lower asymptote M, x100 (default 0.2; clamped 0..1)"
  cpi:
    type: int
    default: 1600
    description: "Sensor CPI used to normalize velocity (dpi-correction = 1000/cpi)"
  start-disabled:
    type: boolean
    description: "Boot with acceleration off (runtime enable over the Flask protocol)"
```

## dts/bindings/input_processors/zmk,input-processor-flask-automouse.yaml
```yaml
description: "Flask auto-mouse layer — motion threshold, timeout/latch, extend-on-key; runtime-tunable over the Flask protocol (channel 0x1B)"

compatible: "zmk,input-processor-flask-automouse"

include: ip_zero_param.yaml

properties:
  layer:
    type: int
    required: true
    description: "Layer INDEX the ball motion activates (the app's Target-layer dropdown writes this)"
  timeout-ms:
    type: int
    default: 750
    description: "Layer drops this long after the last motion. 0 = latch until a key transparent on the layer is pressed (that key is swallowed)"
  threshold:
    type: int
    default: 0
    description: "Accumulated |dx|+|dy| counts before the layer triggers; 0 = any motion (stock temp-layer feel)"
  no-extend-on-key:
    type: boolean
    description: "Do NOT re-arm the timeout when a non-transparent key on the layer is pressed (default is to extend)"
  require-prior-idle-ms:
    type: int
    default: 0
    description: "Motion within this window after a keycode never triggers the layer (mid-typing guard)"
  excluded-positions:
    type: array
    description: "Key positions that never deactivate/swallow — always-on mouse buttons that are transparent ON the layer; they extend instead"
  start-disabled:
    type: boolean
    description: "Boot with the auto-mouse engine off (runtime enable over the Flask protocol)"
```

## dts/bindings/input_processors/zmk,input-processor-flask-autoscroll.yaml
```yaml
# SPDX-License-Identifier: MIT
description: |
  Flask autoscroll — hands-free continuous scrolling. Stepped mode moves a
  signed speed level (-9..9) whose magnitude picks a tick interval from the
  canonical table {1000,500,200,100,67,50,40,33,25} ms. Wheel ticks are
  emitted as REL_WHEEL from this node — attach a second zmk,input-listener
  to route them onward. Control via the &asc behavior (ASC_UP / ASC_DOWN /
  ASC_STOP).

compatible: "zmk,input-processor-flask-autoscroll"

include: ip_zero_param.yaml

properties:
  speed-scale:
    type: int
    default: 100
    description: "Speed scale x100: 100 = interval table as-is, 200 = twice as fast. Clamped 25..400."

  inverted:
    type: boolean
    description: Invert scroll direction (natural vs classic).

  stop-on-key:
    type: int
    default: 1
    description: "Any other key press stops autoscroll (1 = on, 0 = off; runtime-tunable)."
```

## dts/bindings/input_processors/zmk,input-processor-flask-ballswap.yaml
```yaml
# SPDX-License-Identifier: MIT
description: "Flask trackball role swap — swallows motion while a swap is in effect and re-emits it from this node for the other role's listener chain (Flask protocol channel 0x1B)"

compatible: "zmk,input-processor-flask-ballswap"

include: ip_zero_param.yaml
```

## dts/bindings/input_processors/zmk,input-processor-flask-gestures.yaml
```yaml
# SPDX-License-Identifier: MIT
description: "Flask runtime mouse gestures — ratchet engine (drashna pd_gestures port), table/set/step live over the Flask protocol (channel 0x11)"

compatible: "zmk,input-processor-flask-gestures"

include: ip_zero_param.yaml
```

## dts/bindings/input_processors/zmk,input-processor-flask-scroll.yaml
```yaml
# SPDX-License-Identifier: MIT
description: |
  Flask PACS-safe scroll converter. Turns relative X/Y motion into wheel
  notches through an integer divisor (remainder carried between events),
  emits notches on a fixed interval with a per-interval cap, and carries
  surplus notches into later intervals. No counts are lost to the cap, fast
  rolls cannot flood slow applications, and a direction reversal first
  cancels pending surplus instead of emitting a burst the wrong way.

  The processor swallows REL_X/REL_Y and re-emits REL_WHEEL/REL_HWHEEL as
  its own input device — attach a second zmk,input-listener to this node to
  route the wheel events onward (e.g. through zip_scroll_snap).

compatible: "zmk,input-processor-flask-scroll"

include: ip_zero_param.yaml

properties:
  divisor:
    type: int
    default: 8
    description: Ball counts per wheel notch (Flask defaults: 8 PC, 120 macOS).

  interval-ms:
    type: int
    default: 16
    description: Dump interval in milliseconds.

  max-notches:
    type: int
    default: 3
    description: Maximum notches emitted per interval, per axis.

  invert-x:
    type: boolean
    description: Invert horizontal wheel output.

  invert-y:
    type: boolean
    description: Invert vertical wheel output.
```

## dts/bindings/input_processors/zmk,input-processor-flask-scrollscale.yaml
```yaml
# SPDX-License-Identifier: MIT
description: "Flask runtime scroll speed scaler — the stock ZMK scaler with a live speed percent applied to the compiled divisor (Flask protocol channel 0x29)"

compatible: "zmk,input-processor-flask-scrollscale"

include: ip_two_param.yaml

properties:
  type:
    type: int
    required: true
  codes:
    type: array
    required: true
```

## dts/bindings/input_processors/zmk,input-processor-flask-scrollsnap.yaml
```yaml
# SPDX-License-Identifier: MIT
description: "Flask scroll axis snap/lock — runtime-tunable port of kot149/zmk-scroll-snap (Flask protocol channel 0x26)"

compatible: "zmk,input-processor-flask-scrollsnap"

include: ip_zero_param.yaml

properties:
  threshold-pct:
    type: int
    default: 63
    description: "Axis share of recent motion that wins the snap, percent (50 = instant snap, 99 = almost never; clamped 50..99)"
  samples:
    type: int
    default: 8
    description: "Decision window size in wheel events (clamped 1..32)"
  immediate-threshold:
    type: int
    default: 25
    description: "Motion sum that forces a decision before the window fills (0 = wait for the window)"
  lock-ms:
    type: int
    default: 250
    description: "Hold the winning axis this long after the last agreeing event (0 = off)"
  lock-events:
    type: int
    default: 0
    description: "Hold the winning axis for this many events (0 = off)"
  idle-reset-ms:
    type: int
    default: 300
    description: "Pause that clears the window and any lock (0 = off)"
  start-disabled:
    type: boolean
    description: "Boot with snapping off (runtime enable over the Flask protocol)"
```
