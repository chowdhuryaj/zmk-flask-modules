## dts/bindings/behaviors/zmk,behavior-flask-adaptive.yaml
```yaml
# SPDX-License-Identifier: MIT
description: |
  "Flask runtime adaptive-key trigger behavior. Param selects the adaptive
  set; the set's rules and fallback (output depends on the last key typed)
  are live-editable over the Flask protocol (channel 0x2B)."

compatible: "zmk,behavior-flask-adaptive"

properties:
  display-name:
    type: string
  "#binding-cells":
    type: int
    required: true
    const: 1

binding-cells:
  - param1
```

## dts/bindings/behaviors/zmk,behavior-flask-hold-tap.yaml
```yaml
# SPDX-License-Identifier: MIT
description: |
  "Flask hold-tap: core zmk,behavior-hold-tap semantics with RUNTIME timing.
  tapping-term / flavor / quick-tap / require-prior-idle come from the
  flask_holdtap table, one slot per key position or the node's `slot`
  (Flask channel 0x2A).
  Everything here is compiled per node, exactly as in core."

compatible: "zmk,behavior-flask-hold-tap"

include: two_param.yaml

properties:
  bindings:
    type: phandles
    required: true
  hold-while-undecided:
    type: boolean
  hold-while-undecided-linger:
    type: boolean
  retro-tap:
    type: boolean
  hold-trigger-key-positions:
    type: array
    required: false
    default: []
  hold-trigger-on-release:
    type: boolean
  slot:
    type: int
    description: |
      Timing slot to read instead of the pressed key position. Use a
      VIRTUAL slot (>= the key count) for combo / macro hold-taps so they
      do not share a physical key's timing. The slot count grows to cover
      the highest slot named.
```

## dts/bindings/behaviors/zmk,behavior-flask-os-key.yaml
```yaml
# SPDX-License-Identifier: MIT
description: |
  "OS-aware shortcut. param1 is the chord sent while the OS mode
  (zmk-switch-layout index) is Mac, param2 the chord sent while it is PC.
  Both are &kp-style encoded usages (modifiers in the top byte); 0 sends
  nothing on that OS."

compatible: "zmk,behavior-flask-os-key"

properties:
  display-name:
    type: string
  "#binding-cells":
    type: int
    required: true
    const: 2

binding-cells:
  - param1
  - param2
```

## dts/bindings/behaviors/zmk,behavior-flask-tapdance-slot.yaml
```yaml
# SPDX-License-Identifier: MIT
description: |
  "Fixed-slot Flask runtime tap dance: runs one flask_tapdance slot with no
  binding cell (usable as a hold-tap's tap binding). The slot's term, flags
  and outputs are live-editable over the Flask protocol (channel 0x28),
  same as &ftd <slot>."

compatible: "zmk,behavior-flask-tapdance-slot"

properties:
  display-name:
    type: string
  "#binding-cells":
    type: int
    required: true
    const: 0
  slot:
    type: int
    required: true
    description: "The dance slot this node runs"
```

## dts/bindings/behaviors/zmk,behavior-flask-tapdance.yaml
```yaml
# SPDX-License-Identifier: MIT
description: |
  "Flask runtime tap-dance trigger behavior. Param selects the dance slot;
  the slot's tapping term and per-tap-count outputs are live-editable over
  the Flask protocol (channel 0x28). With a `slot` property the node is a
  fixed-slot dance instead: #binding-cells = <0>, no param (usable as a
  hold-tap's tap binding)."

compatible: "zmk,behavior-flask-tapdance"

properties:
  display-name:
    type: string
  "#binding-cells":
    type: int
    required: true
    enum: [0, 1]
    description: "1 for &ftd <slot>; 0 for a fixed-slot node (needs `slot`)"
  slot:
    type: int
    description: "Fixed dance slot (makes the node take no binding cell)"
```

## dts/bindings/input_processors/zmk,input-processor-flask-mousekeys.yaml
```yaml
# SPDX-License-Identifier: MIT
description: "Flask runtime mouse-key speed and ramp — scales &mmv / &msc output by a live speed percent and a floor + (1-floor)*(t/ramp)^exp ramp (Flask protocol channel 0x2D)"

compatible: "zmk,input-processor-flask-mousekeys"

include: ip_zero_param.yaml

properties:
  scroll:
    type: boolean
    description: "Scroll instance (REL_WHEEL/REL_HWHEEL, scroll knobs). Absent = pointer (REL_X/REL_Y)."
  speed-pct:
    type: int
    default: 100
    description: "Boot speed, percent of the behavior's compiled max (10..400)"
  ramp-ms:
    type: int
    default: 0
    description: "Boot time to full speed in ms (0..3000; 0 = no ramp)"
  exponent:
    type: int
    default: 0
    description: "Boot ramp exponent (0 uniform, 1 linear, 2 quadratic, 3 cubic)"
  floor-pct:
    type: int
    default: 0
    description: "Boot start speed, percent of full speed a movement begins at (0..100; 0 = plain ramp from zero). Pointer instances usually want ~40, scroll 0."
  gap-ms:
    type: int
    default: 60
    description: "Quiet time after which the next event starts a new movement (ramp restarts). Must exceed the behavior's longest gap between events while held."
```
