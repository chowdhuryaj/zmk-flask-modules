/*
 * Default flask_autoscroll instance + &asc control behavior. Wire up from
 * the consuming keymap:
 *
 *   #include <flask_autoscroll.dtsi>
 *   #include <dt-bindings/flask/autoscroll.h>
 *
 *   // stepped autoscroll emits from its own node; a second listener routes
 *   // the wheel ticks onward. The processor never intercepts ball motion,
 *   // so it does NOT go in the trackball's input-processors chain.
 *   / {
 *       flask_autoscroll_out {
 *           compatible = "zmk,input-listener";
 *           device = <&flask_autoscroll>;
 *       };
 *   };
 *
 *   // keymap: &asc ASC_UP / &asc ASC_DOWN / &asc ASC_STOP
 */

/ {
    flask_autoscroll: flask_autoscroll {
        compatible = "zmk,input-processor-flask-autoscroll";
        #input-processor-cells = <0>;
        status = "okay";
    };

    behaviors {
        asc: flask_autoscroll_ctrl {
            compatible = "zmk,behavior-flask-autoscroll";
            #binding-cells = <1>;
        };
    };
};
