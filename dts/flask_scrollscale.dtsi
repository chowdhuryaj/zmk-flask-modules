/*
 * Default flask_scrollscale instances — drop-in replacements for the stock
 * zip_x_scaler / zip_y_scaler on a scroll ball's chain. The compiled divisor
 * stays in the keymap exactly where it was; the app scales it live.
 *
 *   #include <flask_scrollscale.dtsi>
 *   // in the scroll listener, swapping the stock scalers 1:1:
 *   //   input-processors = <... &flask_scroll_scaler_x 1 16
 *   //                       &flask_scroll_scaler_y 1 12
 *   //                       &zip_xy_to_scroll_mapper ...>;
 *
 * Two nodes, one per axis, because the input listener allocates remainder
 * storage per chain ENTRY — one node scaling both axes could not carry a
 * separate X and Y remainder (this is why stock ships zip_x_scaler and
 * zip_y_scaler separately too). `track-remainders` is what asks the listener
 * for that storage; without it sub-notch precision is lost on slow rolls.
 *
 * Speed is module-global: both nodes read the same live percent.
 */

#include <zephyr/dt-bindings/input/input-event-codes.h>

/ {
    flask_scroll_scaler_x: flask_scroll_scaler_x {
        compatible = "zmk,input-processor-flask-scrollscale";
        #input-processor-cells = <2>;
        type = <INPUT_EV_REL>;
        codes = <INPUT_REL_X>;
        track-remainders;
        status = "okay";
    };

    flask_scroll_scaler_y: flask_scroll_scaler_y {
        compatible = "zmk,input-processor-flask-scrollscale";
        #input-processor-cells = <2>;
        type = <INPUT_EV_REL>;
        codes = <INPUT_REL_Y>;
        track-remainders;
        status = "okay";
    };
};
